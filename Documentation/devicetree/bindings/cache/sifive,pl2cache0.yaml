## Documentation/devicetree/bindings/cache/sifive,pl2cache0.yaml
```yaml
# SPDX-License-Identifier: (GPL-2.0 OR BSD-2-Clause)
# Copyright (C) 2023-2024 SiFive, Inc.
%YAML 1.2
---
$id: http://devicetree.org/schemas/cache/sifive,pl2cache0.yaml#
$schema: http://devicetree.org/meta-schemas/core.yaml#

title: SiFive Private L2 Cache Controller

maintainers:
  - Eric Lin <eric.lin@sifive.com>

description:
  The SiFive Private L2 Cache Controller is a per-core cache which communicates
  with both the upstream L1 caches and downstream L3 cache or memory, enabling a
  high-performance cache subsystem.

allOf:
  - $ref: /schemas/cache-controller.yaml#

select:
  properties:
    compatible:
      contains:
        enum:
          - sifive,pl2cache1

  required:
    - compatible

properties:
  compatible:
    oneOf:
      - items:
          - const: sifive,pl2cache0
          - const: sifive,pl2cache1
          - const: cache
      - items:
          - const: sifive,pl2cache1
          - const: cache

  reg:
    maxItems: 1

  cache-block-size: true
  cache-level: true
  cache-sets: true
  cache-size: true
  cache-unified: true

  next-level-cache: true

  sifive,perfmon-counters:
    $ref: /schemas/types.yaml#/definitions/uint32
    default: 0
    description: Number of PMU counter registers

required:
  - compatible
  - reg
  - cache-block-size
  - cache-level
  - cache-sets
  - cache-size
  - cache-unified

additionalProperties: false

examples:
  - |
    cache-controller@10104000 {
        compatible = "sifive,pl2cache1", "cache";
        reg = <0x10104000 0x4000>;
        cache-block-size = <64>;
        cache-level = <2>;
        cache-sets = <512>;
        cache-size = <262144>;
        cache-unified;
        next-level-cache = <&L4>;
        sifive,perfmon-counters = <6>;
    };
```

## Documentation/devicetree/bindings/riscv/physical-memory.yaml
```yaml
# SPDX-License-Identifier: (GPL-2.0-only OR BSD-2-Clause)
%YAML 1.2
---
$id: http://devicetree.org/schemas/riscv/physical-memory.yaml#
$schema: http://devicetree.org/meta-schemas/core.yaml#

title: RISC-V Physical Memory Regions

maintainers:
  - Samuel Holland <samuel.holland@sifive.com>

description:
  The RISC-V Privileged Architecture defines a number of Physical Memory
  Attributes (PMAs) which apply to a given region of memory. These include the
  types of accesses (read, write, execute, LR/SC, and/or AMO) allowed within
  a region, the supported access widths and alignments, the cacheability and
  coherence of the region, and whether or not accesses to the region may have
  side effects.

  Some RISC-V platforms provide multiple physical address mappings for main
  memory or certain peripherals. Each alias of a region generally has different
  PMAs (e.g. cacheable vs non-cacheable), which allows software to dynamically
  select the PMAs for an access by referencing the corresponding alias.

  The RISC-V Supervisor Domains specification defines a platform-specific
  Physical Address Width (PAW), which describes the largest physical address
  supported by a platform. Any access to an address >= 2^PAW is guaranteed to
  raise an access fault, and therefore metadata (e.g. Memory Protection Tables)
  need not be maintained for those addresses.

  On DT-based RISC-V platforms, all of this information is provided by the
  riscv,physical-memory-regions property of the root node.

properties:
  $nodename:
    const: '/'

  riscv,physical-memory-regions:
    $ref: /schemas/types.yaml#/definitions/uint32-matrix
    description:
      A table of physical memory regions. The first entry in the table must
      cover the entire range of physical addresses supported by the platform
      (i.e. 0 to 2^PAW-1) and provides the default PMAs for all addresses not
      covered by another table entry. Remaining table entries provide PMAs for
      more specific physical memory regions, which must be contained within the
      range of entry 0, but which must not overlap with each other.
    minItems: 1
    maxItems: 256
    items:
      minItems: 4
      maxItems: 6
      additionalItems: true
      items:
        - description: CPU physical address (#address-cells)
        - description: >
            Size (#size-cells). For entry 0, if the size is zero, the size is
            assumed to be 2^(32 * #size-cells).
        - description: >
            Flags describing the most restrictive PMAs for any address within
            the region.

            The least significant byte indicates the types of accesses allowed
            for this region. Note that a memory region may support a type of
            access (e.g. AMOs) even if the CPU does not.

            The next byte describes the cacheability, coherence, idempotency,
            and ordering PMAs for this region. It also includes a flag to
            indicate that accesses to a region are unsafe and must be
            prohibited by software (for example using PMPs or Smmpt).

            The third byte is reserved for future PMAs.

            The most significant byte is the index of the lowest-numbered entry
            which this entry is an alias of, if any. Aliases need not be the
            same size, for example if a smaller memory region repeats within a
            larger alias.
        - description: Reserved for describing future PMAs

additionalProperties: true

examples:
  - |
    #include <dt-bindings/riscv/physical-memory.h>

    / {
      compatible = "starfive,jh7100";
      #address-cells = <2>;
      #size-cells = <2>;
      riscv,physical-memory-regions =
          <0x00 0x00000000 0x40 0x00000000 (PMA_RW | PMA_IO) 0x0>,
          <0x00 0x18000000 0x00 0x00020000 (PMA_RWX | PMA_NONCACHEABLE_MEMORY) 0x0>,
          <0x00 0x18080000 0x00 0x00020000 (PMA_RWX | PMA_NONCACHEABLE_MEMORY) 0x0>,
          <0x00 0x41000000 0x00 0x1f000000 (PMA_RWX | PMA_NONCACHEABLE_MEMORY) 0x0>,
          <0x00 0x61000000 0x00 0x1f000000 (PMA_RWXA | PMA_NONCOHERENT_MEMORY | PMR_ALIAS(3)) 0x0>,
          <0x00 0x80000000 0x08 0x00000000 (PMA_RWXA | PMA_NONCOHERENT_MEMORY) 0x0>,
          <0x10 0x00000000 0x08 0x00000000 (PMA_RWX | PMA_NONCACHEABLE_MEMORY | PMR_ALIAS(5)) 0x0>,
          <0x20 0x00000000 0x10 0x00000000 (PMA_RWX | PMA_NONCACHEABLE_MEMORY) 0x0>,
          <0x30 0x00000000 0x10 0x00000000 (PMA_RWXA | PMA_NONCOHERENT_MEMORY | PMR_ALIAS(7)) 0x0>;
    };

...
```

## drivers/gpu/drm/eswin/Kconfig
```kconfig
# SPDX-License-Identifier: GPL-2.0

config DRM_ESWIN
	tristate "DRM Support for Eswin"
	depends on DRM
	select DRM_KMS_HELPER
	help
	  Choose this option if you have a Eswin soc chipset.
	  This driver provides Eswin kernel mode
	  setting and buffer management. It does not
	  provide 2D or 3D acceleration.

config ESWIN_VIRTUAL_DISPLAY
	bool "display content output to debugfs file"
	depends on DRM_ESWIN
	select DEBUG_FS
	help
	  This is a debug feature which capture video content output
	  from display controller. Output path is debugfs/dri/connector/.
	  The content format is ARGB which Alpha is 0 for 8bits.
	  Disabled in default.

config ESWIN_MMU
	bool "MMU support for Eswin display controller"
	depends on DRM_ESWIN
	help
	  This is a memory management function which translate virtual address
	  to physical address. DPU MMU only do address translate, doesn't
	  support security and shareable.

config ESWIN_DW_HDMI
    bool "ESWIN specific extensions for Synopsys DW HDMI"
    depends on DRM_ESWIN
    select CEC_CORE if CEC_NOTIFIER
    select DW_HDMI
    help
      This selects support for ESWIN SoC specific extensions
      for the Synopsys DesignWare HDMI driver. If you want to
      enable HDMI on win2030 based SoC, you should select
      this option.

config DW_HDMI_I2S_AUDIO
    bool "Synopsys Designware I2S Audio interface"
    depends on SND_SOC
    depends on ESWIN_DW_HDMI
    select SND_SOC_HDMI_CODEC
    help
      Support the I2S Audio interface which is part of the Synopsys
      Designware HDMI block.

config DW_HDMI_CEC
    bool "Synopsis Designware CEC interface"
    depends on ESWIN_DW_HDMI
    select CEC_CORE
    select CEC_NOTIFIER
    help
      Support the CEC interface which is part of the Synopsys
      Designware HDMI block.

config DW_HDMI_HDCP
    bool "Synopsis Designware HDCP interface"
    depends on ESWIN_DW_HDMI
    help
      Support the HDCP interface which is part of the Synopsys
      Designware HDMI block.

config DW_HDMI_HDCP2
    tristate "Synopsis Designware HDCP2 interface"
    depends on DW_HDMI_HDCP
    help
      Support the HDCP2 interface which is part of the Synopsys
      Designware HDMI block.
```

## drivers/gpu/drm/img/img-volcanic/Kconfig
```kconfig
config DRM_IMG_VOLCANIC
	tristate "DRM support for PowerVR GPU"
        select DRM_IMG
	select SYNC_FILE
	default n
	help
	  Driver for PowerVR Rogue graphics hardware.

	  Say Y here if your SoC contains a PowerVR Volcanic GPU. For more
	  information, see <http://www.imgtec.com/powervr/>.
```

## sound/soc/codecs/eswin/Kconfig
```kconfig
menuconfig ESWIN_SND_SOC_CODECS
	tristate "ESWIN CODEC drivers"
	default n
	help
	  Say Y or M if you want to add support for codecs attached to
	  the ESWIN Asoc interface. You will also need
	  to select the audio interfaces to support below.

#if ESWIN_SND_SOC_CODECS

config ESWIN_SND_ES8388_CODEC
	tristate "ESWIN Audio es8388 codec"
	depends on ESWIN_SND_SOC_CODECS
	default n
	help
	  ESWIN Audio codec,
	  es8388 codec,
	  this codec is internal

#endif #ESWIN_SND_SOC_CODECS
```

## sound/soc/eswin/Kconfig
```kconfig
menu "SND ESWIN SOC"

config SND_ESWIN_DW_I2S
	tristate "Eswin Dw I2S Device Driver"
	select SND_SOC_GENERIC_DMAENGINE_PCM
	help
	 Say Y or M if you want to add support for I2S driver for
	 Eswin dw I2S device. The device supports up to
	 a maximum of 8 channels each for play and record.
endmenu
```
