## Documentation/devicetree/bindings/clock/eswin,eic7700-hspcrg.yaml
```yaml
# SPDX-License-Identifier: (GPL-2.0-only OR BSD-2-Clause)
%YAML 1.2
---
$id: http://devicetree.org/schemas/clock/eswin,eic7700-hspcrg.yaml#
$schema: http://devicetree.org/meta-schemas/core.yaml#

title: ESWIN EIC7700 HSP Clock and Reset Generator

maintainers:
  - Xuyang Dong <dongxuyang@eswincomputing.com>

description:
  Clock and reset generator for the ESWIN EIC7700 HSP (high-speed peripherals).

properties:
  compatible:
    const: eswin,eic7700-hspcrg

  reg:
    maxItems: 1

  clocks:
    items:
      - description: External 24MHz Oscillator clock
      - description: HSP AXI top clock
      - description: HSP configuration top clock
      - description: MMC top clock
      - description: SATA top clock

  clock-names:
    items:
      - const: xtal24m
      - const: aclk
      - const: cfg
      - const: mmc
      - const: sata

  '#clock-cells':
    const: 1

  '#reset-cells':
    const: 1

required:
  - compatible
  - reg
  - clocks
  - clock-names
  - '#clock-cells'
  - '#reset-cells'

additionalProperties: false

examples:
  - |
    #include <dt-bindings/clock/eswin,eic7700-hsp-clock.h>
    #include <dt-bindings/reset/eswin,eic7700-hsp-reset.h>

    clock-controller@50440000 {
        compatible = "eswin,eic7700-hspcrg";
        reg = <0x50440000 0x2000>;
        clocks = <&xtal24m>, <&clock 186>, <&clock 171>, <&clock 254>,
                 <&clock 187>;
        clock-names = "xtal24m", "aclk", "cfg", "mmc", "sata";
        #clock-cells = <1>;
        #reset-cells = <1>;
    };
```

## Documentation/devicetree/bindings/phy/eswin,eic7700-sata-phy.yaml
```yaml
# SPDX-License-Identifier: GPL-2.0-only OR BSD-2-Clause
%YAML 1.2
---
$id: http://devicetree.org/schemas/phy/eswin,eic7700-sata-phy.yaml#
$schema: http://devicetree.org/meta-schemas/core.yaml#

title: Eswin EIC7700 SoC SATA PHY

maintainers:
  - Yulin Lu <luyulin@eswincomputing.com>
  - Huan He <hehuan1@eswincomputing.com>

properties:
  compatible:
    const: eswin,eic7700-sata-phy

  reg:
    maxItems: 1

  clocks:
    maxItems: 1

  clock-names:
    const: phy

  resets:
    maxItems: 2

  reset-names:
    items:
      - const: port
      - const: phy

  "#phy-cells":
    const: 0

required:
  - compatible
  - reg
  - clocks
  - clock-names
  - resets
  - "#phy-cells"

additionalProperties: false

examples:
  - |
    sata-phy@50440300 {
        compatible = "eswin,eic7700-sata-phy";
        reg = <0x50440300 0x40>;
        clocks = <&hspcrg 17>;
        clock-names = "phy";
        resets = <&hspcrg 0>, <&hspcrg 1>;
        reset-names = "port", "phy";
        #phy-cells = <0>;
    };
```

## drivers/clk/eswin/Kconfig
```kconfig
# SPDX-License-Identifier: GPL-2.0

config COMMON_CLK_ESWIN
	bool

config COMMON_CLK_EIC7700
	bool "EIC7700 Clock Driver"
	depends on ARCH_ESWIN || COMPILE_TEST
	select COMMON_CLK_ESWIN
	default ARCH_ESWIN
	help
	  This driver provides support for clock controller on ESWIN EIC7700
	  SoC. The clock controller can generates and supplies clock to various
	  peripherals within the SoC.
	  Say yes here to support the clock controller on the EIC7700 SoC.
```

## drivers/soc/sifive/Kconfig
```kconfig
# SPDX-License-Identifier: GPL-2.0

if SOC_SIFIVE || SOC_STARFIVE

config SIFIVE_CCACHE
	bool "Sifive Composable Cache controller"
	select RISCV_NONSTANDARD_CACHE_OPS
	help
	  Support for the composable cache controller on SiFive platforms.

endif
```
